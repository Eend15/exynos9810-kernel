## fs/Kconfig.susfs
```kconfig
menu "KernelSU - SUSFS"

config KSU_SUSFS
	bool "KernelSU addon - SUSFS"
	depends on KSU
	default y
	help
	  Patch and Enable SUSFS to kernel.

config KSU_SUSFS_HAS_MAGIC_MOUNT
	bool "Magic Mount support indicator"
	depends on KSU_SUSFS
	default y

config KSU_SUSFS_SUS_PATH
	bool "Enable to hide suspicious path"
	depends on KSU_SUSFS
	default y
	help
	  Allow hiding user-defined path and sub-paths.

config KSU_SUSFS_SUS_MOUNT
	bool "Enable to hide suspicious mounts"
	depends on KSU_SUSFS
	default y
	help
	  Allow hiding user-defined mount paths from /proc/mounts etc.

config KSU_SUSFS_AUTO_ADD_SUS_KSU_DEFAULT_MOUNT
	bool "Enable to hide KSU's default mounts automatically"
	depends on KSU_SUSFS_SUS_MOUNT
	default y

config KSU_SUSFS_AUTO_ADD_SUS_BIND_MOUNT
	bool "Enable to hide bind mounts automatically"
	depends on KSU_SUSFS_SUS_MOUNT
	default y

config KSU_SUSFS_SUS_KSTAT
	bool "Enable to spoof suspicious kstat"
	depends on KSU_SUSFS
	default y

config KSU_SUSFS_SUS_OVERLAYFS
	bool "Enable overlayfs spoofing"
	depends on KSU_SUSFS
	default y

config KSU_SUSFS_TRY_UMOUNT
	bool "Enable try_umount"
	depends on KSU_SUSFS
	default y

config KSU_SUSFS_AUTO_ADD_TRY_UMOUNT_FOR_BIND_MOUNT
	bool "Enable auto add try_umount for bind mount"
	depends on KSU_SUSFS_TRY_UMOUNT
	default y

config KSU_SUSFS_SPOOF_UNAME
	bool "Enable uname spoofing"
	depends on KSU_SUSFS
	default y

config KSU_SUSFS_ENABLE_LOG
	bool "Enable logging susfs log to kernel"
	depends on KSU_SUSFS
	default y

config KSU_SUSFS_HIDE_KSU_SUSFS_SYMBOLS
	bool "Enable to automatically hide ksu and susfs symbols from /proc/kallsyms"
	depends on KSU_SUSFS
	default y

config KSU_SUSFS_SPOOF_CMDLINE_OR_BOOTCONFIG
	bool "Enable spoofing cmdline or bootconfig"
	depends on KSU_SUSFS
	default y

config KSU_SUSFS_OPEN_REDIRECT
	bool "Enable open redirect feature"
	depends on KSU_SUSFS
	default y

config KSU_SUSFS_SUS_SU
	bool "Enable sus_su"
	depends on KSU_SUSFS
	default y

endmenu
```
